## CMakeLists.txt
```
# SPDX-License-Identifier: Apache-2.0

cmake_minimum_required(VERSION 3.20.0)
find_package(Zephyr REQUIRED HINTS $ENV{ZEPHYR_BASE})
project(flash_shell)

FILE(GLOB app_sources src/*.c)
target_sources(app PRIVATE ${app_sources})
```

## sample.yaml
```
sample:
  description: Shell commands for inspecting flash driver behavior
  name: Flash shell
tests:
  sample.drivers.flash.shell:
    tags:
      - flash
      - shell
    filter: CONFIG_FLASH_HAS_DRIVER_ENABLED and dt_chosen_enabled('zephyr,flash-controller')
            and not CONFIG_SOC_SERIES_BSIM_NRFXX
    platform_exclude:
      - stm32h7s78_dk
      - gd32f350r_eval
    harness: shell
    extra_configs:
      - arch:posix:CONFIG_NATIVE_UART_0_ON_STDINOUT=y
    min_ram: 12
    integration_platforms:
      - qemu_x86
      - native_sim
```

## prj.conf
```kconfig
CONFIG_PRINTK=y
CONFIG_SHELL=y
CONFIG_LOG=y
CONFIG_FLASH_SHELL=y
CONFIG_FLASH_SHELL_TEST_COMMANDS=y
#CONFIG_MPU_ALLOW_FLASH_WRITE=y

CONFIG_MAIN_STACK_SIZE=8192
CONFIG_TIMING_FUNCTIONS=y
CONFIG_TICKLESS_KERNEL=n
CONFIG_SYS_CLOCK_TICKS_PER_SEC=10000


CONFIG_FLASH=y
CONFIG_FLASH_PAGE_LAYOUT=y
CONFIG_FLASH_MAP=y
```

## src/main.c
```c
// #include <stdlib.h>
// #include <string.h>
// #include <stdio.h>

// //#include <zephyr.h>
// //#include <sys/printk.h>
// //#include <logging/log.h>
// //#include <shell/shell.h>
// #include <zephyr/kernel.h>
// #include <zephyr/device.h>
// #include <zephyr/drivers/flash.h>
// #include <zephyr/storage/flash_map.h>
// #include <zephyr/device.h>
// //#include <soc.h>

// static const struct device *flash_device;

// uint8_t data[2048];

// void main(void)
// {
//     printk("Flash starting!\n");
// 	int ret;
// 	off_t offset = 0x1F800;
// 	size_t size = 2048;

// 	flash_device = DEVICE_DT_GET(DT_CHOSEN(zephyr_flash_controller));
// 	if (!device_is_ready(flash_device)) {
//         printk("Flash device not ready!\n");
//         return;
//     }

// 	for(int i = 0; i < 2048; i++) {data[i]= i;}
// 	// ret = flash_erase(flash_device, offset, size);
// 	// if (ret) {
// 	// 	printk("flash_erase failed (err:%d).\n", ret);
// 	// 	return;
// 	// }

// 	ret = flash_write(flash_device, offset, &data, FLASH_PAGE_SIZE);
// 	if (ret) {
// 		printk("flash_write failed (err:%d).\n", ret);
// 		return;
// 	}

// 	// ret = flash_write_protection_set(flash_device, true);
// 	// if (ret) {
// 	// 	printk("Failed to enable flash protection (err: %d)."
// 	// 			"\n", ret);
// 	// 	return;
// 	// }

// 	printk("Erase OK");

// 	printk("Reading back...\n");
//     uint8_t buf[2048];
//     ret = flash_read(flash_device, offset, buf, FLASH_PAGE_SIZE);
//     if (ret) {
//         printk("Read failed: %d\n", ret);
//         return;
//     }

// 	for(int i = 0; i < 2048; i++) {
// 		if(buf[i] != data[i]) {
// 			printk("Data mismatch at index %d: expected %d, got %d\n", i, data[i], buf[i]);
// 			return;
// 		}
// 	}
// 	printk("Data verified successfully!\n");

// }


#include <stdio.h>
#include <stdlib.h>
#include <string.h>
#include <stdio.h>

#include <zephyr/kernel.h>
#include <zephyr/device.h>
#include <zephyr/drivers/flash.h>
#include <zephyr/storage/flash_map.h>
#include <zephyr/device.h>
#include <zephyr/timing/timing.h>


int main(void)
{
	timing_init(); timing_start();
	const struct device *flash_device;
    printk("Flash shell sample\n");

	int ret;
	off_t offset = 0x48000;
	int num_pages = 2;

	size_t erase_size = num_pages * FLASH_PAGE_SIZE;

	flash_device = DEVICE_DT_GET(DT_CHOSEN(zephyr_flash_controller));
	if (!device_is_ready(flash_device)) {
        printk("Flash device not ready!\n");
        return;
    }
    printk("Ready to flash, disabling interrupts first\n");

	uint64_t start = timing_counter_get();
	int64_t t1 = k_uptime_ticks();


	//__disable_irq();
	unsigned int key = irq_lock();
	ret = flash_erase(flash_device, offset, erase_size);
	if (ret) {
		printk("flash_erase failed (err:%d).\n", ret);
		return;
	}
    printk("Flash erase succeeds\n");

	uint8_t data[FLASH_PAGE_SIZE];
	for(int i = 0; i < 2048; i++) {data[i]= i;}

	for(int j=0; j<num_pages; j++) {
		ret = flash_write(flash_device, offset+j*FLASH_PAGE_SIZE, &data, FLASH_PAGE_SIZE);
		if (ret) {
			printk("flash_write failed (err:%d) at page %d.\n", ret, j);
			return;
		}
	}
    printk("Flash write succeeds\n");

	printk("Reading back...\n");
    uint8_t buf[2048];
	for(int j=0; j<num_pages; j++) {
		ret = flash_read(flash_device, offset+j*FLASH_PAGE_SIZE, buf, FLASH_PAGE_SIZE);
		if (ret) {
			printk("Read failed: %d\n", ret);
			return;
		}

		for(int i = 0; i < 2048; i++) {
			if(buf[i] != data[i]) {
				printk("Data mismatch at page %d index %d: expected %d, got %d\n", j, i, data[i], buf[i]);
				return;
			}
		}
	}
	//__enable_irq();
	irq_unlock(key);

	uint64_t end = timing_counter_get();
	int64_t t2 = k_uptime_ticks();

    uint64_t cycles = end - start;
    uint64_t ns = timing_cycles_to_ns(cycles);
    uint64_t us = ns / 1000;
	float s = (float)us/(1000*1000.0f);

    printk("Elapsed: %llu ns (%llu us, %.3f s) raw_cycles=%llu\n", ns, us, s, cycles);

	int64_t dt_ticks = t2 - t1;
    uint64_t dt_ms = k_ticks_to_ms_floor64(dt_ticks);
	printk("Elapsed (uptime ticks): %llu ms, %llu ticks\n", dt_ms, dt_ticks);


    timing_stop();
	printk("Data verified successfully!\n");

    return 0;
}
```
